## conf/machine/beaglebone.conf
```bitbake
#@TYPE: Machine
#@NAME: BeagleBone machine
#@DESCRIPTION: Machine configuration for the http://beagleboard.org/bone board 

require conf/machine/include/ti33x.inc

# Only has DVI connector for external screen
GUI_MACHINE_CLASS = "smallscreen"
MACHINE_FEATURES += "touchscreen"

IMAGE_FSTYPES += "tar.gz"

SERIAL_CONSOLE = "115200 ttyO0"

UBOOT_MACHINE = "am335x_boneblack_config"

PREFERRED_PROVIDER_virtual/kernel = "linux-beagleboard-org"
MACHINE_EXTRA_RRECOMMENDS = " kernel-modules"
LINUX_KERNEL_TYPE = "tiny"

PREFERRED_PROVIDER_jpeg = "jpeg"
PREFERRED_PROVIDER_jpeg-native = "jpeg-native"

PREFERRED_VERSION_libgles-omap3 = "5.01.01.02"
PREFERRED_PROVIDER_virtual/egl = "libgles-omap3"
PREFERRED_PROVIDER_virtual/libgles1 = "libgles-omap3"
PREFERRED_PROVIDER_virtual/libgles2 = "libgles-omap3"

PACKAGECONFIG_append_pn-qtbase = " tslib"
```
